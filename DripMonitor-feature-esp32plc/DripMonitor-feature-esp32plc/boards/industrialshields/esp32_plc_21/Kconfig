## DripMonitor-feature-esp32plc/DripMonitor-feature-esp32plc/boards/industrialshields/esp32_plc_21/Kconfig
```kconfig
# SPDX-License-Identifier: Apache-2.0

config HEAP_MEM_POOL_ADD_SIZE_BOARD
	int
	default 4096 if BOARD_ESP32_PLC_21_ESP32_PROCPU
```

## DripMonitor-feature-esp32plc/DripMonitor-feature-esp32plc/boards/industrialshields/esp32_plc_21/Kconfig.esp32_plc_21
```kconfig
# SPDX-License-Identifier: Apache-2.0

config BOARD_ESP32_PLC_21
	select SOC_ESP32_WROOM_32UE_N16
	select SOC_ESP32_PROCPU if BOARD_ESP32_PLC_21_ESP32_PROCPU
```

## DripMonitor-feature-esp32plc/DripMonitor-feature-esp32plc/boards/industrialshields/esp32_plc_21/Kconfig.sysbuild
```kconfig
# SPDX-License-Identifier: Apache-2.0

choice BOOTLOADER
	default BOOTLOADER_ESP_IDF
endchoice

choice BOOT_SIGNATURE_TYPE
	default BOOT_SIGNATURE_TYPE_NONE
endchoice
```

## DripMonitor-feature-esp32plc/DripMonitor-feature-esp32plc/boards/industrialshields/esp32_plc_21/board.yml
```yaml
board:
  name: esp32_plc_21
  full_name: Industrial Shields ESP32 PLC 21 (V3)
  vendor: industrialshields
  socs:
    - name: esp32
```

## DripMonitor-feature-esp32plc/DripMonitor-feature-esp32plc/boards/industrialshields/esp32_plc_21/esp32_plc_21_esp32_procpu_defconfig
```kconfig
# SPDX-License-Identifier: Apache-2.0

# --- Console / serial ---
CONFIG_CONSOLE=y
CONFIG_SERIAL=y
CONFIG_UART_CONSOLE=y
CONFIG_UART_INTERRUPT_DRIVEN=y

# --- Buses required by on-board peripherals ---
CONFIG_GPIO=y
CONFIG_I2C=y
CONFIG_SPI=y

# --- On-board peripheral drivers (always present on the PLC 21 hardware) ---
CONFIG_GPIO_MCP230XX=y      # I0_0..I0_4 expander (MCP23008 @ 0x21)
CONFIG_ADC=y
CONFIG_ADC_ADS1X1X=y        # I0_7..I0_12 ADS1015 ADCs
CONFIG_PWM=y
CONFIG_PWM_PCA9685=y        # Q0_0..Q0_7 output driver
CONFIG_COUNTER=y
CONFIG_RTC=y
CONFIG_MFD=y                # required by RTC_DS3231 (uses MFD parent node)
CONFIG_RTC_DS3231=y         # battery-backed RTC

# --- Networking via WIZnet W5500 SPI Ethernet ---
# The W5500 INT pin is not exposed on the PLC 21 PCB, so the driver must
# run in polled mode.
CONFIG_NETWORKING=y
CONFIG_NET_L2_ETHERNET=y
CONFIG_ETH_DRIVER=y
CONFIG_ETH_W5500=y

# --- Watchdog: required for the fail-safe behaviour of the PCA9685 outputs.
# If the CPU hangs, the hardware watchdog reboots the chip; the firmware
# clears all PCA9685 outputs early in `SYS_INIT()` so the loads are forced
# OFF within seconds of any lock-up.
CONFIG_WATCHDOG=y
CONFIG_WDT_DISABLE_AT_BOOT=n

# --- Storage (NVS lives in the `storage` partition defined by the SoC dtsi). ---
CONFIG_FLASH=y
CONFIG_FLASH_MAP=y

# --- Misc ---
CONFIG_ENTROPY_GENERATOR=y
# Note: CONFIG_HW_STACK_PROTECTION is unavailable on Xtensa LX6 (ESP32)
# because the architecture does not select ARCH_HAS_STACK_PROTECTION.
# Stack overrun detection is instead provided by CONFIG_STACK_SENTINEL or
# CONFIG_THREAD_ANALYZER, which can be enabled in prj.conf if needed.
```

## DripMonitor-feature-esp32plc/build/esp32_plc_21/Kconfig/Kconfig.shield.defconfig
```kconfig
osource "C:/Projects/DripMonitor-feature-esp32plc/DripMonitor-feature-esp32plc/boards/shields/*/Kconfig.defconfig"
```

## DripMonitor-feature-esp32plc/build/esp32_plc_21/Kconfig/arch/Kconfig.tmp
```kconfig
# Load Zephyr Arch Kconfig descriptions.
osource "C:/Projects/DripMonitor-feature-esp32plc/zephyr/arch/rx/Kconfig"
osource "C:/Projects/DripMonitor-feature-esp32plc/zephyr/arch/x86/Kconfig"
osource "C:/Projects/DripMonitor-feature-esp32plc/zephyr/arch/xtensa/Kconfig"
osource "C:/Projects/DripMonitor-feature-esp32plc/zephyr/arch/sparc/Kconfig"
osource "C:/Projects/DripMonitor-feature-esp32plc/zephyr/arch/riscv/Kconfig"
osource "C:/Projects/DripMonitor-feature-esp32plc/zephyr/arch/posix/Kconfig"
osource "C:/Projects/DripMonitor-feature-esp32plc/zephyr/arch/openrisc/Kconfig"
osource "C:/Projects/DripMonitor-feature-esp32plc/zephyr/arch/mips/Kconfig"
osource "C:/Projects/DripMonitor-feature-esp32plc/zephyr/arch/arm64/Kconfig"
osource "C:/Projects/DripMonitor-feature-esp32plc/zephyr/arch/arm/Kconfig"
osource "C:/Projects/DripMonitor-feature-esp32plc/zephyr/arch/arc/Kconfig"
```

## DripMonitor-feature-esp32plc/build/esp32_plc_21/Kconfig/boards/Kconfig
```kconfig
# Load Zephyr board Kconfig descriptions.
osource "C:/Projects/DripMonitor-feature-esp32plc/DripMonitor-feature-esp32plc/boards/industrialshields/esp32_plc_21/Kconfig"
```

## DripMonitor-feature-esp32plc/build/esp32_plc_21/Kconfig/boards/Kconfig.defconfig.tmp
```kconfig
# Load Zephyr board defconfig descriptions.
osource "C:/Projects/DripMonitor-feature-esp32plc/DripMonitor-feature-esp32plc/boards/industrialshields/esp32_plc_21/Kconfig.defconfig"
```

## DripMonitor-feature-esp32plc/build/esp32_plc_21/Kconfig/soc/Kconfig
```kconfig
# Load Zephyr SoC Kconfig descriptions.
osource "C:/Projects/DripMonitor-feature-esp32plc/zephyr/soc/xlnx/zynqmp/Kconfig"
osource "C:/Projects/DripMonitor-feature-esp32plc/zephyr/soc/xlnx/zynq7000/Kconfig"
osource "C:/Projects/DripMonitor-feature-esp32plc/zephyr/soc/xlnx/versalnet/Kconfig"
osource "C:/Projects/DripMonitor-feature-esp32plc/zephyr/soc/xlnx/versal2/Kconfig"
osource "C:/Projects/DripMonitor-feature-esp32plc/zephyr/soc/xlnx/versal/Kconfig"
osource "C:/Projects/DripMonitor-feature-esp32plc/zephyr/soc/xen/Kconfig"
osource "C:/Projects/DripMonitor-feature-esp32plc/zephyr/soc/wch/ch32v/Kconfig"
osource "C:/Projects/DripMonitor-feature-esp32plc/zephyr/soc/ti/simplelink/Kconfig"
osource "C:/Projects/DripMonitor-feature-esp32plc/zephyr/soc/ti/mspm0/Kconfig"
osource "C:/Projects/DripMonitor-feature-esp32plc/zephyr/soc/ti/lm3s6965/Kconfig"
osource "C:/Projects/DripMonitor-feature-esp32plc/zephyr/soc/ti/k3/Kconfig"
osource "C:/Projects/DripMonitor-feature-esp32plc/zephyr/soc/telink/tlsr/Kconfig"
osource "C:/Projects/DripMonitor-feature-esp32plc/zephyr/soc/syna/sr100/Kconfig"
osource "C:/Projects/DripMonitor-feature-esp32plc/zephyr/soc/starfive/jh71xx/Kconfig"
osource "C:/Projects/DripMonitor-feature-esp32plc/zephyr/soc/st/stm32/Kconfig"
osource "C:/Projects/DripMonitor-feature-esp32plc/zephyr/soc/snps/qemu_arc/Kconfig"
osource "C:/Projects/DripMonitor-feature-esp32plc/zephyr/soc/snps/nsim/arc_v/Kconfig"
osource "C:/Projects/DripMonitor-feature-esp32plc/zephyr/soc/snps/nsim/arc_classic/Kconfig"
osource "C:/Projects/DripMonitor-feature-esp32plc/zephyr/soc/snps/hsdk4xd/Kconfig"
osource "C:/Projects/DripMonitor-feature-esp32plc/zephyr/soc/snps/hsdk/Kconfig"
osource "C:/Projects/DripMonitor-feature-esp32plc/zephyr/soc/snps/emsk/Kconfig"
osource "C:/Projects/DripMonitor-feature-esp32plc/zephyr/soc/snps/emsdp/Kconfig"
osource "C:/Projects/DripMonitor-feature-esp32plc/zephyr/soc/snps/arc_iot/Kconfig"
osource "C:/Projects/DripMonitor-feature-esp32plc/zephyr/soc/silabs/Kconfig"
osource "C:/Projects/DripMonitor-feature-esp32plc/zephyr/soc/sifli/sf32/Kconfig"
osource "C:/Projects/DripMonitor-feature-esp32plc/zephyr/soc/sifive/sifive_freedom/Kconfig"
osource "C:/Projects/DripMonitor-feature-esp32plc/zephyr/soc/sensry/Kconfig"
osource "C:/Projects/DripMonitor-feature-esp32plc/zephyr/soc/rockchip/Kconfig"
osource "C:/Projects/DripMonitor-feature-esp32plc/zephyr/soc/renode/riscv_virtual/Kconfig"
osource "C:/Projects/DripMonitor-feature-esp32plc/zephyr/soc/renode/cortex_r8_virtual/Kconfig"
osource "C:/Projects/DripMonitor-feature-esp32plc/zephyr/soc/renesas/smartbond/Kconfig"
osource "C:/Projects/DripMonitor-feature-esp32plc/zephyr/soc/renesas/rz/Kconfig"
osource "C:/Projects/DripMonitor-feature-esp32plc/zephyr/soc/renesas/rx/Kconfig"
osource "C:/Projects/DripMonitor-feature-esp32plc/zephyr/soc/renesas/rcar/Kconfig"
osource "C:/Projects/DripMonitor-feature-esp32plc/zephyr/soc/renesas/ra/Kconfig"
osource "C:/Projects/DripMonitor-feature-esp32plc/zephyr/soc/realtek/fingerprint/Kconfig"
osource "C:/Projects/DripMonitor-feature-esp32plc/zephyr/soc/realtek/ec/Kconfig"
osource "C:/Projects/DripMonitor-feature-esp32plc/zephyr/soc/realtek/bee/Kconfig"
osource "C:/Projects/DripMonitor-feature-esp32plc/zephyr/soc/realtek/ameba/Kconfig"
osource "C:/Projects/DripMonitor-feature-esp32plc/zephyr/soc/raspberrypi/rpi_pico/Kconfig"
osource "C:/Projects/DripMonitor-feature-esp32plc/zephyr/soc/quicklogic/eos_s3/Kconfig"
osource "C:/Projects/DripMonitor-feature-esp32plc/zephyr/soc/qemu/virt_riscv/Kconfig"
osource "C:/Projects/DripMonitor-feature-esp32plc/zephyr/soc/qemu/or1k/Kconfig"
osource "C:/Projects/DripMonitor-feature-esp32plc/zephyr/soc/qemu/malta/Kconfig"
osource "C:/Projects/DripMonitor-feature-esp32plc/zephyr/soc/openisa/rv32m1/Kconfig"
osource "C:/Projects/DripMonitor-feature-esp32plc/zephyr/soc/openhwgroup/cva6/Kconfig"
osource "C:/Projects/DripMonitor-feature-esp32plc/zephyr/soc/oct/osd32mp15x/Kconfig"
osource "C:/Projects/DripMonitor-feature-esp32plc/zephyr/soc/nxp/s32/Kconfig"
osource "C:/Projects/DripMonitor-feature-esp32plc/zephyr/soc/nxp/rw/Kconfig"
osource "C:/Projects/DripMonitor-feature-esp32plc/zephyr/soc/nxp/mcx/Kconfig"
osource "C:/Projects/DripMonitor-feature-esp32plc/zephyr/soc/nxp/lpc/Kconfig"
osource "C:/Projects/DripMonitor-feature-esp32plc/zephyr/soc/nxp/layerscape/Kconfig"
osource "C:/Projects/DripMonitor-feature-esp32plc/zephyr/soc/nxp/kinetis/Kconfig"
osource "C:/Projects/DripMonitor-feature-esp32plc/zephyr/soc/nxp/imxrt/Kconfig"
osource "C:/Projects/DripMonitor-feature-esp32plc/zephyr/soc/nxp/imx/Kconfig"
osource "C:/Projects/DripMonitor-feature-esp32plc/zephyr/soc/nuvoton/numicro/Kconfig"
osource "C:/Projects/DripMonitor-feature-esp32plc/zephyr/soc/nuvoton/numaker/Kconfig"
osource "C:/Projects/DripMonitor-feature-esp32plc/zephyr/soc/nuvoton/npcx/Kconfig"
osource "C:/Projects/DripMonitor-feature-esp32plc/zephyr/soc/nuvoton/npcm/Kconfig"
osource "C:/Projects/DripMonitor-feature-esp32plc/zephyr/soc/nordic/Kconfig"
osource "C:/Projects/DripMonitor-feature-esp32plc/zephyr/soc/neorv32/Kconfig"
osource "C:/Projects/DripMonitor-feature-esp32plc/zephyr/soc/native/inf_clock/Kconfig"
osource "C:/Projects/DripMonitor-feature-esp32plc/zephyr/soc/microchip/sam/sama7/Kconfig"
osource "C:/Projects/DripMonitor-feature-esp32plc/zephyr/soc/microchip/sam/sam_d5x_e5x/Kconfig"
osource "C:/Projects/DripMonitor-feature-esp32plc/zephyr/soc/microchip/pic64/Kconfig"
osource "C:/Projects/DripMonitor-feature-esp32plc/zephyr/soc/microchip/pic32c/pic32cz_ca/Kconfig"
osource "C:/Projects/DripMonitor-feature-esp32plc/zephyr/soc/microchip/pic32c/pic32cx_sg/Kconfig"
osource "C:/Projects/DripMonitor-feature-esp32plc/zephyr/soc/microchip/pic32c/pic32cm_pl/Kconfig"
osource "C:/Projects/DripMonitor-feature-esp32plc/zephyr/soc/microchip/pic32c/pic32cm_jh/Kconfig"
osource "C:/Projects/DripMonitor-feature-esp32plc/zephyr/soc/microchip/miv/Kconfig"
osource "C:/Projects/DripMonitor-feature-esp32plc/zephyr/soc/microchip/mec/Kconfig"
osource "C:/Projects/DripMonitor-feature-esp32plc/zephyr/soc/mediatek/mt8xxx/Kconfig"
osource "C:/Projects/DripMonitor-feature-esp32plc/zephyr/soc/lowrisc/opentitan/Kconfig"
osource "C:/Projects/DripMonitor-feature-esp32plc/zephyr/soc/litex/litex_vexriscv/Kconfig"
osource "C:/Projects/DripMonitor-feature-esp32plc/zephyr/soc/ite/ec/Kconfig"
osource "C:/Projects/DripMonitor-feature-esp32plc/zephyr/soc/intel/wildcat_lake/Kconfig"
osource "C:/Projects/DripMonitor-feature-esp32plc/zephyr/soc/intel/raptor_lake/Kconfig"
osource "C:/Projects/DripMonitor-feature-esp32plc/zephyr/soc/intel/panther_lake/Kconfig"
osource "C:/Projects/DripMonitor-feature-esp32plc/zephyr/soc/intel/lakemont/Kconfig"
osource "C:/Projects/DripMonitor-feature-esp32plc/zephyr/soc/intel/intel_socfpga_std/Kconfig"
osource "C:/Projects/DripMonitor-feature-esp32plc/zephyr/soc/intel/intel_socfpga/Kconfig"
osource "C:/Projects/DripMonitor-feature-esp32plc/zephyr/soc/intel/intel_niosv/Kconfig"
osource "C:/Projects/DripMonitor-feature-esp32plc/zephyr/soc/intel/intel_ish/Kconfig"
osource "C:/Projects/DripMonitor-feature-esp32plc/zephyr/soc/intel/intel_adsp/Kconfig"
osource "C:/Projects/DripMonitor-feature-esp32plc/zephyr/soc/intel/elkhart_lake/Kconfig"
osource "C:/Projects/DripMonitor-feature-esp32plc/zephyr/soc/intel/atom/Kconfig"
osource "C:/Projects/DripMonitor-feature-esp32plc/zephyr/soc/intel/apollo_lake/Kconfig"
osource "C:/Projects/DripMonitor-feature-esp32plc/zephyr/soc/intel/alder_lake/Kconfig"
osource "C:/Projects/DripMonitor-feature-esp32plc/zephyr/soc/infineon/psoc4/Kconfig"
osource "C:/Projects/DripMonitor-feature-esp32plc/zephyr/soc/infineon/edge/Kconfig"
osource "C:/Projects/DripMonitor-feature-esp32plc/zephyr/soc/infineon/cat3/Kconfig"
osource "C:/Projects/DripMonitor-feature-esp32plc/zephyr/soc/infineon/cat1c/Kconfig"
osource "C:/Projects/DripMonitor-feature-esp32plc/zephyr/soc/infineon/cat1b/Kconfig"
osource "C:/Projects/DripMonitor-feature-esp32plc/zephyr/soc/infineon/cat1a/Kconfig"
osource "C:/Projects/DripMonitor-feature-esp32plc/zephyr/soc/gd/gd32/Kconfig"
osource "C:/Projects/DripMonitor-feature-esp32plc/zephyr/soc/gaisler/leon3/Kconfig"
osource "C:/Projects/DripMonitor-feature-esp32plc/zephyr/soc/gaisler/gr716a/Kconfig"
osource "C:/Projects/DripMonitor-feature-esp32plc/zephyr/soc/focaltech/Kconfig"
osource "C:/Projects/DripMonitor-feature-esp32plc/zephyr/soc/espressif/Kconfig"
osource "C:/Projects/DripMonitor-feature-esp32plc/zephyr/soc/ene/kb1200/Kconfig"
osource "C:/Projects/DripMonitor-feature-esp32plc/zephyr/soc/ene/kb106x/Kconfig"
osource "C:/Projects/DripMonitor-feature-esp32plc/zephyr/soc/elan/em32f967/Kconfig"
osource "C:/Projects/DripMonitor-feature-esp32plc/zephyr/soc/egis/Kconfig"
osource "C:/Projects/DripMonitor-feature-esp32plc/zephyr/soc/efinix/sapphire/Kconfig"
osource "C:/Projects/DripMonitor-feature-esp32plc/zephyr/soc/cdns/xtensa_sample_controller/Kconfig"
osource "C:/Projects/DripMonitor-feature-esp32plc/zephyr/soc/cdns/swerv/Kconfig"
osource "C:/Projects/DripMonitor-feature-esp32plc/zephyr/soc/cdns/sample_controller32/Kconfig"
osource "C:/Projects/DripMonitor-feature-esp32plc/zephyr/soc/cdns/dc233c/Kconfig"
osource "C:/Projects/DripMonitor-feature-esp32plc/zephyr/soc/brcm/bcmvk/Kconfig"
osource "C:/Projects/DripMonitor-feature-esp32plc/zephyr/soc/brcm/bcm2712/Kconfig"
osource "C:/Projects/DripMonitor-feature-esp32plc/zephyr/soc/brcm/bcm2711/Kconfig"
osource "C:/Projects/DripMonitor-feature-esp32plc/zephyr/soc/blackberry/qnxhv_vm/Kconfig"
osource "C:/Projects/DripMonitor-feature-esp32plc/zephyr/soc/bflb/Kconfig"
osource "C:/Projects/DripMonitor-feature-esp32plc/zephyr/soc/atmel/sam0/Kconfig"
osource "C:/Projects/DripMonitor-feature-esp32plc/zephyr/soc/atmel/sam/Kconfig"
osource "C:/Projects/DripMonitor-feature-esp32plc/zephyr/soc/aspeed/Kconfig"
osource "C:/Projects/DripMonitor-feature-esp32plc/zephyr/soc/arm/Kconfig"
osource "C:/Projects/DripMonitor-feature-esp32plc/zephyr/soc/arm/beetle/Kconfig"
osource "C:/Projects/DripMonitor-feature-esp32plc/zephyr/soc/antmicro/myra/Kconfig"
osource "C:/Projects/DripMonitor-feature-esp32plc/zephyr/soc/andestech/Kconfig"
osource "C:/Projects/DripMonitor-feature-esp32plc/zephyr/soc/amd/acp_6_0/Kconfig"
osource "C:/Projects/DripMonitor-feature-esp32plc/zephyr/soc/ambiq/Kconfig"
osource "C:/Projects/DripMonitor-feature-esp32plc/zephyr/soc/allwinner/sun8i_h3/Kconfig"
osource "C:/Projects/DripMonitor-feature-esp32plc/zephyr/soc/alif/ensemble/Kconfig"
osource "C:/Projects/DripMonitor-feature-esp32plc/zephyr/soc/aesc/Kconfig"
osource "C:/Projects/DripMonitor-feature-esp32plc/zephyr/soc/adi/max32/Kconfig"
```
